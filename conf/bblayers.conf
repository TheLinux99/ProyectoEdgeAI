## conf/bblayers.conf
```bitbake
# POKY_BBLAYERS_CONF_VERSION is increased each time build/conf/bblayers.conf
# changes incompatibly
POKY_BBLAYERS_CONF_VERSION = "2"

BBPATH = "${TOPDIR}"
BBFILES ?= ""

BBLAYERS ?= " \
  /home/linux/Documents/Git-Repositorys/Yocto/poky/meta \
  /home/linux/Documents/Git-Repositorys/Yocto/poky/meta-poky \
  /home/linux/Documents/Git-Repositorys/Yocto/poky/meta-yocto-bsp \
  /home/linux/Documents/Git-Repositorys/Yocto/poky/meta-openembedded/meta-oe \
  /home/linux/Documents/Git-Repositorys/Yocto/poky/meta-openembedded/meta-python \
  /home/linux/Documents/Git-Repositorys/Yocto/poky/meta-openembedded/meta-networking \
  /home/linux/Documents/Git-Repositorys/Yocto/poky/meta-openembedded/meta-multimedia \
  /home/linux/Documents/Git-Repositorys/Yocto/poky/meta-raspberrypi \
  /home/linux/Documents/Git-Repositorys/Yocto/poky/meta-tensorflow-lite \
  /home/linux/Documents/Git-Repositorys/Yocto/poky/meta-ia \
  /home/linux/Documents/Git-Repositorys/Yocto/poky/meta-FastEmotRecognition \
  "
```

## poky/meta-FastEmotRecognition/conf/layer.conf
```bitbake
# We have a conf and classes directory, add to BBPATH
BBPATH .= ":${LAYERDIR}"

# We have recipes-* directories, add to BBFILES
BBFILES += "${LAYERDIR}/recipes-*/*/*.bb \
            ${LAYERDIR}/recipes-*/*/*.bbappend"

BBFILE_COLLECTIONS += "meta-FastEmotRecognition"
BBFILE_PATTERN_meta-FastEmotRecognition = "^${LAYERDIR}/"
BBFILE_PRIORITY_meta-FastEmotRecognition = "6"

LAYERDEPENDS_meta-FastEmotRecognition = "core"
LAYERSERIES_COMPAT_meta-FastEmotRecognition = "hardknott"
```

## poky/meta-ia/conf/layer.conf
```bitbake
# We have a conf and classes directory, add to BBPATH
BBPATH .= ":${LAYERDIR}"

# We have recipes-* directories, add to BBFILES
BBFILES += "${LAYERDIR}/recipes-*/*/*.bb \
            ${LAYERDIR}/recipes-*/*/*.bbappend"

BBFILE_COLLECTIONS += "meta-ia"
BBFILE_PATTERN_meta-ia = "^${LAYERDIR}/"
BBFILE_PRIORITY_meta-ia = "6"

LAYERDEPENDS_meta-ia = "core"
LAYERSERIES_COMPAT_meta-ia = "hardknott"
```
